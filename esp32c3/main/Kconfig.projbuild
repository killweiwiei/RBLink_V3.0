## esp32c3/main/Kconfig.projbuild
```kconfig
menu "RBlink wireless bridge"

config RBLINK_AP_SSID_PREFIX
    string "SoftAP SSID prefix"
    default "RBlink"
    help
        The final SSID is this prefix followed by the last three MAC bytes.

config RBLINK_AP_PASSWORD
    string "SoftAP WPA2 password"
    default "RBlinkV30!"
    help
        Must contain 8 to 63 characters. Change this before releasing a product.

config RBLINK_TCP_PORT
    int "RBlink TCP port"
    range 1024 65535
    default 3240

config RBLINK_SPI_QUEUE_DEPTH
    int "Inter-task frame queue depth"
    range 2 32
    default 8

endmenu
```

## esp32c3/sdkconfig.defaults
```kconfig
CONFIG_IDF_TARGET="esp32c3"
CONFIG_ESPTOOLPY_FLASHSIZE_4MB=y
CONFIG_ESPTOOLPY_FLASHSIZE="4MB"
CONFIG_PARTITION_TABLE_SINGLE_APP_LARGE=y
CONFIG_ESP_MAIN_TASK_STACK_SIZE=4096
CONFIG_FREERTOS_HZ=1000
CONFIG_LWIP_MAX_SOCKETS=12
CONFIG_ESP_WIFI_SOFTAP_SUPPORT=y
CONFIG_ESP_WIFI_STA_DISCONNECTED_PM_ENABLE=n
CONFIG_ESP_CONSOLE_UART_DEFAULT=y
CONFIG_RBLINK_AP_SSID_PREFIX="RBlink"
CONFIG_RBLINK_AP_PASSWORD="RBlinkV30!"
CONFIG_RBLINK_TCP_PORT=3240
CONFIG_RBLINK_SPI_QUEUE_DEPTH=8
CONFIG_HTTPD_WS_SUPPORT=y
```
